## Documentation/devicetree/bindings/arm64/low-pin-count.txt
```
Low Pin Count bus driver

Usually LPC controller is part of PCI host bridge, so the legacy ISA
port locate on LPC bus can be accessed directly. But some SoC have
independent LPC controller, and we can access the legacy port by specifying
LPC address cycle. Thus, LPC driver is introduced.

Required properties:
- compatible: "low-pin-count"
- reg: specifies low pin count address range

Example:

	lpc_0: lpc@a01b0000 {
		#address-cells = <1>;
		#size-cells = <1>;
                compatible = "low-pin-count";
                reg = <0x0 0xa01b0000 0x0 0x10000>;
        };
```

## Documentation/devicetree/bindings/gpio/gpio-hi6220.txt
```
Hisilicon Hi6220 GPIO controller bindings

Required properties:
	- compatible: "arm,pl061","arm,primecell"
	- gpio-controller: Marks the device node as a GPIO controller.
	- #gpio-cells: Should be 2. See gpio.txt in this directory for a
		 description of	the cells format.
	- interrupt-controller: Mark the device node as an interrupt controller

Example:

	gpio0: gpio@f8011000 {
		compatible = "arm,pl061", "arm,primecell";
		reg = <0x0 0xf8011000 0x0 0x1000>;
		interrupts = <0	52 0x4>;
		gpio-controller;
		#gpio-cells = <2>;
		interrupt-controller;
		#interrupt-cells = <2>;
		clocks = <&ao_ctrl 2>;
		clock-names = "apb_pclk";
		status = "ok";
	};
```

## Documentation/devicetree/bindings/scsi/hisilicon-sas.txt
```
* HiSilison SAS controller

The HiSilicon SAS controller supports SAS/SATA.

Main node required properties:
  - compatible : value should be as follows:
	(a) "hisilicon,sas-controller-v1" for v1 of HiSilicon SAS controller IP
	(a) "hisilicon,sas-controller-v2" for v2 of HiSilicon SAS controller IP

  - controller-id : identifier for controller in the SoC

  - reg : Address and length of the register sets for the device
   - SAS controller registers
   - SAS controller control registers

  - reset-reg : offset to reset and clock registers in control registers

  - queue-count : number of delivery and completion queues in the controller

  - phy-count : number of phys accessible by the controller

  - interrupts : Interrupts for phys, completion queues, and fatal
		 interrupts:
		  - Each phy has 4 interrupt sources:
			- broadcast
			- phyup
			- abnormal
			- reg set 1 interrupts
		  - Each completion queue has 1 interrupt source
		  - Each controller has 2 fatal interrupt sources:
			- ECC
			- AXI bus

Example:
	sas0: sas@c1000000 {
		compatible = "hisilicon,sas-controller-v1";
		controller-id = <0>;
		reg = <0x0 0xc1000000 0x0 0x10000>,
			<0x0 0xc0000000 0x0 0x10000>;
		reset-reg = <0xa60 0x338>;
		queue-count = <32>;
		phy-count = <8>;
		#interrupt-cells = <2>;
		dma-coherent;
		interrupt-parent = <&mbigen_dsa>;
		interrupts = <259 4>,<263 4>,<264 4>,<265 4>,
				<269 4>,<273 4>,<274 4>,<275 4>,
				<279 4>,<283 4>,<284 4>,<285 4>,
				<289 4>,<293 4>,<294 4>,<295 4>,
				<299 4>,<303 4>,<304 4>,<305 4>,
				<309 4>,<313 4>,<314 4>,<315 4>,
				<319 4>,<323 4>,<324 4>,<325 4>,
				<329 4>,<333 4>,<334 4>,<335 4>,
				<336 1>,<337 1>,<338 1>,<339 1>,<340 1>,<341 1>,<342 1>,<343 1>,
				<344 1>,<345 1>,<346 1>,<347 1>,<348 1>,<349 1>,<350 1>,<351 1>,
				<352 1>,<353 1>,<354 1>,<355 1>,<356 1>,<357 1>,<358 1>,<359 1>,
				<360 1>,<361 1>,<362 1>,<363 1>,<364 1>,<365 1>,<366 1>,<367 1>,
				<376 4>,
				<381 4>;
		status = "okay";
	};
```

## Documentation/devicetree/bindings/serial/hisi-lpc-uart.txt
```
* Hisilicon DesignWare lpc UART

Required properties:
- compatible : "hisilicon,16550-lpc-uart"
- reg : offset and length of the register set for the device.

Clock handling:
The clock rate of the input clock needs to be supplied by one of
- clocks : phandle to the input clock

The supplying peripheral clock can also be handled, needing a second property
- clock-names: tuple listing input clock names.

Optional properties:

- reg-shift : quantity to shift the register offsets by.  If this property is
  not present then the register offsets are not shifted.

Example:

	uart1: uart@02f8 {
		compatible = "hisilicon,16550-lpc-uart";
		reg = <0 0x02f8 0x0 0x100>;
		clocks = <&refclk18461mhz>;
		clock-names = "clk";
		reg-shift = <0>;
	};
```

## arch/arm64/configs/estuary_defconfig
```kconfig
CONFIG_UEVENT_HELPER=y
CONFIG_SCSI_HISI_SAS=y
CONFIG_MEGARAID_SAS=y
CONFIG_HNS=y
CONFIG_HNS_DSAF=y
CONFIG_HNS_ENET=y
CONFIG_USB_OHCI_HCD=y
CONFIG_USB_OHCI_HCD_PLATFORM=y
CONFIG_NFS_V2=y
CONFIG_NFS_V3=y
CONFIG_RT_GROUP_SCHED=y
CONFIG_IPV6=y
CONFIG_BRIDGE_NETFILTER=y
CONFIG_NF_CONNTRACK=m
CONFIG_NF_NAT=m
CONFIG_NETFILTER_XT_MATCH_ADDRTYPE=y
CONFIG_NETFILTER_XT_MATCH_CONNTRACK=y
CONFIG_NF_CONNTRACK_IPV4=m
CONFIG_NF_NAT_IPV4=m
CONFIG_IP_NF_IPTABLES=m
CONFIG_IP_NF_FILTER=m
CONFIG_IP_NF_NAT=y
CONFIG_IP_NF_TARGET_MASQUERADE=y
CONFIG_BRIDGE=y
CONFIG_NET_CLS_CGROUP=y
CONFIG_DM_THIN_PROVISIONING=y
CONFIG_MACVLAN=y
CONFIG_VETH=y
CONFIG_EXT4_FS=y
CONFIG_BTRFS_FS=y
CONFIG_OVERLAY_FS=y
CONFIG_BLK_DEV_RAM=m
CONFIG_DRM_HISI_HIBMC=y
CONFIG_SATA_AHCI=y
# CONFIG_FUJITSU_ES is not set
CONFIG_EFI_VARS=y
CONFIG_VIRTIO_MMIO=y
CONFIG_VIRTIO_MMIO_CMDLINE_DEVICES=y
# CONFIG_HVC_IRQ is not set
# CONFIG_HVC_XEN is not set
# CONFIG_HVC_XEN_FRONTEND is not set
# CONFIG_HVC_DCC is not set
CONFIG_ATA=y
CONFIG_CDROM_PKTCDVD=y
CONFIG_ISO9660_FS=y
CONFIG_BLK_DEV_SR=y
CONFIG_BLK_DEV_LOOP=y
CONFIG_PCI_HISI_ACPI=y
CONFIG_HISILICON_LPC=y
CONFIG_SCSI_SAS_ATA=y
CONFIG_SCSI_LOWLEVEL=y
CONFIG_SERIAL_8250_HISI_LPC=y
CONFIG_IPMI_HANDLER=y
CONFIG_IPMI_PANIC_EVENT=y
CONFIG_IPMI_DEVICE_INTERFACE=y
CONFIG_IPMI_SI=y
CONFIG_IXGBE=y
CONFIG_IGB=y
CONFIG_NVM=y
CONFIG_BLK_DEV_NVME=y
CONFIG_BLK_DEV_NVME_SCSI=y
CONFIG_NUMA_BALANCING=y
CONFIG_NUMA_BALANCING_DEFAULT_ENABLED=y
CONFIG_TRANSPARENT_HUGEPAGE_ALWAYS=y
# CONFIG_TRANSPARENT_HUGEPAGE_MADVISE is not set
# CONFIG_PREEMPT_NONE is not set
CONFIG_PREEMPT_VOLUNTARY=y
CONFIG_SCHED_DEBUG=y
CONFIG_DEFAULT_DEADLINE=y
CONFIG_DEFAULT_IOSCHED="deadline"
```

## arch/arm64/configs/qemu_defconfig
```kconfig
CONFIG_VIRTIO_MMIO=y
CONFIG_VIRTIO_MMIO_CMDLINE_DEVICES=y
# CONFIG_HVC_IRQ is not set
# CONFIG_HVC_XEN is not set
# CONFIG_HVC_XEN_FRONTEND is not set
# CONFIG_HVC_DCC is not set
```

## drivers/gpu/drm/hisilicon/hibmc/Kconfig
```kconfig
config DRM_HISI_HIBMC
	tristate "DRM Support for Hisilicon Hibmc"
	depends on DRM && PCI
	select DRM_KMS_HELPER
	select DRM_KMS_FB_HELPER
	select DRM_GEM_CMA_HELPER
	select DRM_KMS_CMA_HELPER
	select FB_SYS_FILLRECT
	select FB_SYS_COPYAREA
	select FB_SYS_IMAGEBLIT
	help
	  Choose this option if you have a Hisilicon Hibmc soc chipset.
	  If M is selected the module will be called hibmc-drm.
```

## drivers/misc/hisi-djtag/Kconfig
```kconfig
config HISI_DJTAG
        bool "hisilicon djtag r/w interface via syscon"
	depends on ARCH_HISI
        help
          This enables support djtag r/w for some modules.
```

## drivers/misc/hisi-nmi/Kconfig
```kconfig
menu "HISI NMI Feature Test Function"

config HISI_NMI_DEMO
	bool "HISI NMI Feature Demo"
	default n
	help
	  Reg the NMI feature on the HISI PV660 board. To test this function,
	  the CONFIG_HISI_AARCH64_NMI Should be Enabled.

endmenu
```

## drivers/scsi/hisi_sas/Kconfig
```kconfig
config SCSI_HISI_SAS
	tristate "HiSilicon SAS"
	select SCSI_SAS_LIBSAS
	select BLK_DEV_INTEGRITY
	select SCSI_SAS_ATA
	help
		This driver supports HiSilicon's SAS HBA
```

## drivers/scsi/hisisas/Kconfig
```kconfig
source "drivers/scsi/hisisas/sas/Kconfig"
source "drivers/scsi/hisisas/chips/Kconfig"
```

## drivers/scsi/hisisas/chips/Kconfig
```kconfig
config SCSI_HISISAS_PV660
	tristate "Hisilicon PV660 sas HBA driver support"
	select SCSI_HISISAS_COMMON
	default y
	---help---
	  This driver supports Hisilicon PV660 sas controller.
```

## drivers/scsi/hisisas/sas/Kconfig
```kconfig
config SCSI_HISISAS_COMMON
	tristate "Hisilicon sas/sata common driver support"
	default y
	---help---
	  This driver supports sas/sata protocol related process for all Hisilicon sas controller.
```

## drivers/staging/lynxfb/Kconfig
```kconfig
config FB_LYNXFB
	tristate "Silicon Motion lynx framebuffer support"
	depends on FB && PCI
	select FB_MODE_HELPERS
	select FB_CFB_FILLRECT
	select FB_CFB_COPYAREA
	select FB_CFB_IMAGEBLIT
	help
	  Frame buffer driver for Lynx Express sm750 graphic chip

	  This driver is also available as a module. The module will be
	  called lynxfb. If you want to compile it as a module, say M
	  here and read <file:Documentation/kbuild/modules.txt>.

config FB_LYNXFB_DEBUG
        bool "Silicon Motion lynx framebuffer debugging"
        depends on FB_LYNXFB
        help
        Enables extra debugging.
```
