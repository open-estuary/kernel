
/**
 * Huawei Ltd.
 * PhosphorV660
 */

/ {
	p0_sas1: sas@0xb1000000 {
		compatible = "hisilicon,p660-sas";
		interrupt-parent = <&mbigen_pcie>;
		controller-id = <1>;
		nodes = <1>;			/* 1: 1P ARM SERVER; 2: 2P ARM SERVER */
		node-id = <0>;			/* 0: MASTER CPU; 1: SLAVE CPU */
		hilink-type = "pcie";
		reg = <0x0 0xb1000000 0x0 0x10000>;
		interrupts = <256 4>, <257 4>,<258 4>,<259 4>,<260 4>,<261 4>,<262 4>,<263 4>,<264 4>,<265 4>,/* phy irq(0~79) */
				 <266 4>, <267 4>,<268 4>,<269 4>,<270 4>,<271 4>,<272 4>,<273 4>,<274 4>,<275 4>,/* phy irq(0~79) */
				 <276 4>, <277 4>,<278 4>,<279 4>,<280 4>,<281 4>,<282 4>,<283 4>,<284 4>,<285 4>,/* phy irq(0~79) */
				 <286 4>, <287 4>,<288 4>,<289 4>,<290 4>,<291 4>,<292 4>,<293 4>,<294 4>,<295 4>,/* phy irq(0~79) */
				 <296 4>, <297 4>,<298 4>,<299 4>,<300 4>,<301 4>,<302 4>,<303 4>,<304 4>,<305 4>,/* phy irq(0~79) */
				 <306 4>, <307 4>,<308 4>,<309 4>,<310 4>,<311 4>,<312 4>,<313 4>,<314 4>,<315 4>,/* phy irq(0~79) */
				 <316 4>, <317 4>,<318 4>,<319 4>,<320 4>,<321 4>,<322 4>,<323 4>,<324 4>,<325 4>,/* phy irq(0~79) */
				 <326 4>, <327 4>,<328 4>,<329 4>,<330 4>,<331 4>,<332 4>,<333 4>,<334 4>,<335 4>,/* phy irq(0~79) */
				<336 1>, <337 1>,<338 1>,<339 1>,<340 1>,<341 1>,<342 1>,<343 1>,/* cq irq (80~111) */
				<344 1>, <345 1>,<346 1>,<347 1>,<348 1>,<349 1>,<350 1>,<351 1>,/* cq irq (80~111) */
				<352 1>, <353 1>,<354 1>,<355 1>,<356 1>,<357 1>,<358 1>,<359 1>,/* cq irq (80~111) */
				<360 1>, <361 1>,<362 1>,<363 1>,<364 1>,<365 1>,<366 1>,<367 1>,/* cq irq (80~111) */
				<376 4>, /* chip fatal error irq(120) */
				<381 4>; /* chip fatal error irq(125) */
		phy-num = <8>;
		phy-useage = <0xff>;	
		phy0-addr-high = <0xB2020304>;
		phy1-addr-high = <0xB2020304>;
		phy2-addr-high = <0xB2020304>;
		phy3-addr-high = <0xB2020304>;
		phy4-addr-high = <0xB2020304>;
		phy5-addr-high = <0xB2020304>;
		phy6-addr-high = <0xB2020304>;
		phy7-addr-high = <0xB2020304>;
		phy0-addr-low = <0x05060708>;                   
		phy1-addr-low = <0x05060708>;         
		phy2-addr-low = <0x05060708>;         
		phy3-addr-low = <0x05060708>;         
		phy4-addr-low = <0x05060708>;         
		phy5-addr-low = <0x05060708>;         
		phy6-addr-low = <0x05060708>;         
		phy7-addr-low = <0x05060708>;    
		phy0-g3-trasmit = <0x00000000>;
		phy1-g3-trasmit = <0x00000000>;
		phy2-g3-trasmit = <0x00000000>;
		phy3-g3-trasmit = <0x00000000>;
		phy4-g3-trasmit = <0x00000000>;
		phy5-g3-trasmit = <0x00000000>;
		phy6-g3-trasmit = <0x00000000>;
		phy7-g3-trasmit = <0x00000000>;

		port-num = <2>;	
		port0-bit-map = <0x0f>; /* port0:phy0~phy3 */
		port1-bit-map = <0xf0>;/* port1:phy4~phy7 */
	
		dma-coherent;
	};

	cpld@98000000 {
		compatible = "hisilicon,p660-cpld";
		reg = <0x0 0x98000000 0x0 0x100>;
		/* reboot-key-val = [10 55]; */
		/* poweroff-key-val = [3a 01]; */
};

};
