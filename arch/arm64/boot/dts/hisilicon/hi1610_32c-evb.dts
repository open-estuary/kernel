/**
 * dts file for Hisilicon Hi1610 32c EVB
 *
 * Copyright (C) 2014,2015 Hisilicon Ltd.
 *
 * This program is free software; you can redistribute it and/or modify
 * it under the terms of the GNU General Public License version 2 as
 * publishhed by the Free Software Foundation.
 *
 */

/dts-v1/;

/memreserve/ 0x00000000 0x00010000;
/include/ "hi1610_32c.dtsi"
/include/ "hi1610_hns_evb.dtsi"
/include/ "hi1610_pcie_evb.dtsi"
/ {
	model = "Hisilicon Hi1610 32core Evaluation Board";
	compatible = "hisilicon,hi1610_32c-EVB", "hisilicon,hi1610";

	memory@0 {
		device_type = "memory";
		reg = <0x0 0x00000000 0x0 0x3c000000>;
	};

	chosen {
		bootargs = "rdinit=/init console=ttyS0,115200 earlycon=uart8250,mmio32,0x60300000";
		linux,initrd-start = <0x7000000>;
		linux,initrd-end = <0x20000000>;
	};
};
